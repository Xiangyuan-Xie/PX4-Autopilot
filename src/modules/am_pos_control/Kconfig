## src/modules/am_pos_control/Kconfig
```kconfig
menuconfig MODULES_AM_POS_CONTROL
	bool "am_pos_control"
	default n
	---help---
		Enable support for the AM Position direct-actuator controller.

menuconfig USER_AM_POS_CONTROL
	bool "am_pos_control running as userspace module"
	default n
	depends on BOARD_PROTECTED && MODULES_AM_POS_CONTROL
	---help---
		Put am_pos_control in userspace memory.
```

## src/modules/rl_mc_arm_control/Kconfig
```kconfig
menuconfig MODULES_RL_MC_ARM_CONTROL
	bool "rl_mc_arm_control"
	default n
	---help---
		Enable support for the RL multicopter arm direct-actuator controller.

menuconfig USER_RL_MC_ARM_CONTROL
	bool "rl_mc_arm_control running as userspace module"
	default n
	depends on BOARD_PROTECTED && MODULES_RL_MC_ARM_CONTROL
	---help---
		Put rl_mc_arm_control in userspace memory.
```
