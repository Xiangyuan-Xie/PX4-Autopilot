## src/modules/am_pose_control/Kconfig
```kconfig
menuconfig MODULES_AM_POSE_CONTROL
	bool "am_pose_control"
	default n
	---help---
		Enable support for the AM Pose direct-actuator controller.

menuconfig USER_AM_POSE_CONTROL
	bool "am_pose_control running as userspace module"
	default n
	depends on BOARD_PROTECTED && MODULES_AM_POSE_CONTROL
	---help---
		Put am_pose_control in userspace memory.
```
